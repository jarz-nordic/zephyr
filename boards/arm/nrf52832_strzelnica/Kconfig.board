## boards/arm/nrf52832_strzelnica/Kconfig.board
```kconfig
# nRF52 STRZELNICA BOARD board configuration

# Copyright (c) 2020 Jakub Rzeszutko
# SPDX-License-Identifier: Apache-2.0

config BOARD_NRF52832_STRZELNICA
	bool "nRF52 NRF52832 STRZELNICA"
	depends on SOC_NRF52832_QFAA
```

## dts/bindings/power/nordic,nrf-pmgt-consumer.yaml
```yaml
# Copyright (c) 2020 Nordic Semiconductor ASA
# SPDX-License-Identifier: Apache-2.0

description: Nordic PMGT Consumer

compatible: "nordic,nrf-pmgt-consumer"

include: base.yaml

properties:
    parents:
        required: true
        type: phandles
        description: Parents to which consumer is connected.
```

## dts/bindings/power/nordic,nrf-pmgt-mode-req.yaml
```yaml
# Copyright (c) 2020 Nordic Semiconductor ASA
# SPDX-License-Identifier: Apache-2.0

description: Nordic PMGT Consumer mode requirement

compatible: "nordic,nrf-pmgt-mode-req"

include: base.yaml

properties:
    min_volt:
        required: true
        type: int
        description: Minimum voltage supported in mV.
    max_volt:
        required: true
        type: int
        description: Maximum voltage supported in mV.
    clean:
        required: false
        type: boolean
        description: Is the voltage required to be clean.
    rail:
        required: true
        type: phandle
        description: Node of rail that this requirement concerns.
```

## dts/bindings/power/nordic,nrf-pmgt-rail.yaml
```yaml
# Copyright (c) 2020 Nordic Semiconductor ASA
# SPDX-License-Identifier: Apache-2.0

description: Nordic PMGT power rail

compatible: "nordic,nrf-pmgt-rail"

include: base.yaml

properties:
    volt:
        required: true
        type: int
        description: Nominal voltage in mV.
    parents:
        required: true
        type: phandles
        description: Parents to which rail is connected.
```

## dts/bindings/power/nordic,nrf-pmgt-reg-out.yaml
```yaml
# Copyright (c) 2020 Nordic Semiconductor ASA
# SPDX-License-Identifier: Apache-2.0

description: Nordic PMGT Regulator output

compatible: "nordic,nrf-pmgt-reg-out"

include: base.yaml

properties:
    min_volt:
        required: true
        type: int
        description: Minimum voltage generated in mV.
    max_volt:
        required: true
        type: int
        description: Maximum voltage generated in mV.
    efficiency:
        required: true
        type: int
        description: Mode efficiency in %.
    drop:
        required: true
        type: int
        description: Voltage drop in mV.
    time_comm:
        required: true
        type: int
        description: Base time required to change voltage in us.
    time_alpha:
        required: true
        type: int
        description: Time required for voltage change dependent on voltage delta in us.
                     Total time to change voltage = time_comm + (deltaV * time_alpha) 
    bypass:
        required: false
        type: boolean
        description: Is this output a bypass.
    rail:
        required: true
        type: phandle
        description: Node of rail connected to this output.
```

## dts/bindings/power/nordic,nrf-pmgt-reg.yaml
```yaml
# Copyright (c) 2020 Nordic Semiconductor ASA
# SPDX-License-Identifier: Apache-2.0

description: Nordic PMGT Regulator

compatible: "nordic,nrf-pmgt-reg"

include: base.yaml

properties:
    parents:
        required: false
        type: phandles
        description: Parents to which regulator is connected.
    clean:
        required: false
        type: boolean
        description: Is voltage provided by regulator clean.
        
```

## lib/util/getopt/Kconfig
```kconfig
# Copyright (c) 2021 Nordic Semiconductor
# SPDX-License-Identifier: Apache-2.0


config GETOPT
	bool "Geopt library support"
	help
	  This option adds support of the multi-instance getopt.
	  Different shell backends use their own instance of getopt state
	  structure.
	  There are two options if one wants to use getopt functions from
	  outside the shell thread. If getopt is called from only one thread
	  it can be done straight forward. The getopt functions will use
	  a single getopt state structure created in the lib_getoptvars.c
	  file.
	  However, if getopt is expected to be called from multiple threads,
	  you must modify the struct getopt_s *getoptvars(void) function
	  in the lib_getoptvars.c file so that it returns a separate getopt
	  state structure for each thread.
```

## modules/Kconfig.nrfs
```kconfig
config NRFS
	bool "nRF Services Support"
	help
	  This option enables the nRF Services library
```

## subsys/pm/Kconfig
```kconfig
# SPDX-License-Identifier: LicenseRef-BSD-5-Clause-Nordic

config PM_ENABLE
	bool "Enable Power Management"

module = PM
module-str = Power Management
source "subsys/logging/Kconfig.template.log_config"
```

## tests/subsys/shell/shell_getopt/testcase.yaml
```yaml
tests:
  shell.getopt:
    integration_platforms:
      - native_posix
    min_flash: 64
    min_ram: 32
    filter: ( CONFIG_SHELL )
    tags: flash shell
```

## tests/unity/Kconfig
```kconfig
#
# Copyright (c) 2019 Nordic Semiconductor
#
# SPDX-License-Identifier: LicenseRef-BSD-5-Clause-Nordic
#

rsource "fake_event_manager/Kconfig"

config UNITY
	bool "Use Unity test framework"
```

## tests/unity/fake_event_manager/Kconfig
```kconfig
#
# Copyright (c) 2020 Nordic Semiconductor
#
# SPDX-License-Identifier: LicenseRef-BSD-5-Clause-Nordic
#

config FAKE_EVENT_MANAGER
	bool "Use Fake Event Manager."
	depends on UNITY
	depends on !EVENT_MANAGER
	help
	  Use this module if you need to test application using
	  event manager
```
