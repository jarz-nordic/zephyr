## CMakeLists.txt
```
#
# Copyright (c) 2019 Nordic Semiconductor
#
# SPDX-License-Identifier: LicenseRef-BSD-5-Clause-Nordic
#

cmake_minimum_required(VERSION 3.13.1)

find_package(Zephyr REQUIRED HINTS $ENV{ZEPHYR_BASE})
project(test_shell)

# generate runner for the test
test_runner_generate(src/test_shell.c)

# create mock for module.
cmock_handle($ENV{ZEPHYR_BASE}/include/shell/shell_fprintf.h shell)
cmock_handle($ENV{ZEPHYR_BASE}/include/shell/shell_history.h shell)
cmock_handle($ENV{ZEPHYR_BASE}/include/shell/shell_log_backend.h shell)
cmock_handle($ENV{ZEPHYR_BASE}/include/shell/shell_uart.h shell)


# add test file
target_sources(app PRIVATE src/test_shell.c)
target_include_directories(app PRIVATE .)
```

## sample.yaml
```
sample:
  description: Example Unity/Cmock test
  name: test_shell
```

## prj.conf
```kconfig
#
# Copyright (c) 2019 Nordic Semiconductor ASA
#
# SPDX-License-Identifier: LicenseRef-BSD-5-Clause-Nordic
#
CONFIG_UNITY=y
CONFIG_SHELL=y
```

## src/test_shell.c
```c
/*
 * Copyright (c) 2019 Nordic Semiconductor ASA
 *
 * SPDX-License-Identifier: LicenseRef-BSD-5-Clause-Nordic
 */
#include <unity.h>
#include <stdbool.h>
#include <shell/shell.h>

void setUp(void)
{
}

void test_uut_init(void)
{
}

void test_shell_prompt_change(void)
{
	int ret;
	struct shell shell;

	ret = shell_prompt_change(&shell, NULL);

	TEST_ASSERT_EQUAL(ret, -EINVAL);
}

/* It is required to be added to each test. That is because unity is using
 * different main signature (returns int) and zephyr expects main which does
 * not return value.
 */
extern int unity_main(void);

void main(void)
{
	(void)unity_main();
}
```
