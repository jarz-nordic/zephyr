## CMakeLists.txt
```
cmake_minimum_required(VERSION 3.13.1)
# Top-level CMakeLists.txt for the skeleton application.
#
# Copyright (c) 2017 Open Source Foundries Limited
#
# SPDX-License-Identifier: Apache-2.0
#
# This provides a basic application structure suitable for communication using
# mcumgr.  It can be used as a starting point for new applications.

# Standard Zephyr application boilerplate.
find_package(Zephyr REQUIRED HINTS $ENV{ZEPHYR_BASE})
project(strzelnica)

target_include_directories(app PRIVATE src/inc)

target_sources(app PRIVATE src/main.c)
target_sources(app PRIVATE src/config.c)
target_sources(app PRIVATE src/motor.c)
target_sources(app PRIVATE src/encoder.c)
target_sources(app PRIVATE src/state_machine.c)
target_sources(app PRIVATE src/led.c)
target_sources(app PRIVATE src/buttons.c)
target_sources(app PRIVATE src/pid.c)
target_sources_ifdef(CONFIG_MCUMGR_SMP_BT app PRIVATE src/bluetooth.c)
```

## prj.conf
```kconfig
CONFIG_BT_DIS=y
CONFIG_BT_DIS_MODEL="Transporter BT"
CONFIG_BT_DIS_MANUF="projekty@rzeszutko.eu"
CONFIG_BT_DIS_FW_REV=y
CONFIG_BT_DIS_FW_REV_STR="1.0.4"
CONFIG_BT_DIS_HW_REV=y
CONFIG_BT_DIS_HW_REV_STR="1.0.1"
CONFIG_HEAP_MEM_POOL_SIZE=4098
CONFIG_BT_DEVICE_NAME="Transporter Kacer"
CONFIG_BT_PERIPHERAL=y
CONFIG_BT_SMP=y

# Enable mcumgr.
CONFIG_MCUMGR=y

# Some command handlers require a large stack.
CONFIG_SYSTEM_WORKQUEUE_STACK_SIZE=2048

# Ensure an MCUboot-compatible binary is generated.
CONFIG_BOOTLOADER_MCUBOOT=y

# Enable flash operations.
CONFIG_FLASH=y

# Required by the `taskstat` command.
CONFIG_THREAD_MONITOR=y

#Enable ADC driver
CONFIG_ADC=y
CONFIG_ADC_SHELL=n

# Enable statistics and statistic names.
CONFIG_STATS=y
CONFIG_STATS_NAMES=y

# Enable most core commands.
CONFIG_MCUMGR_CMD_IMG_MGMT=y
CONFIG_MCUMGR_CMD_OS_MGMT=y
CONFIG_MCUMGR_CMD_STAT_MGMT=y

# Enable logging
CONFIG_LOG=y
CONFIG_GPIO=y

CONFIG_SETTINGS=y
CONFIG_NVS=y
CONFIG_SHELL=y
CONFIG_MCUMGR_SMP_UART=n

CONFIG_SENSOR=y
CONFIG_QDEC_NRFX=y

# Shell settings
CONFIG_SHELL=y
CONFIG_SHELL_CMD_BUFF_SIZE=64
CONFIG_SHELL_PROMPT_UART=">"
CONFIG_SHELL_ARGC_MAX=5
CONFIG_LOG_PRINTK=y
CONFIG_CBPRINTF_NANO=y

CONFIG_PWM=y
CONFIG_PWM_SHELL=n

# Disable unwanted options:
CONFIG_FLASH_SHELL=n
CONFIG_SHELL_VT100_COLORS=n
CONFIG_SHELL_WILDCARD=n
CONFIG_SHELL_METAKEYS=n
CONFIG_SHELL_STATS=n
CONFIG_SHELL_CMDS=n
CONFIG_SHELL_HISTORY=y
CONFIG_SHELL_HISTORY_BUFFER=130
CONFIG_SHELL_HELP=n
CONFIG_DEVICE_SHELL=n
CONFIG_SENSOR_SHELL=n
CONFIG_LOG_RUNTIME_FILTERING=n
CONFIG_LOG_CMDS=n
CONFIG_CLOCK_CONTROL_NRF_SHELL=n
```

## overlay-bt-tiny.conf
```kconfig
### This configuration enables fewer settings than the default, making it
### suitable for a device with 32kB of RAM and 72kB image slots (e.g.,
### nRF51).

# Allow for large Bluetooth data packets.
CONFIG_BT_L2CAP_TX_MTU=252
CONFIG_BT_L2CAP_RX_MTU=252
CONFIG_BT_RX_BUF_LEN=260

# Enable the Bluetooth (unauthenticated) and UART mcumgr transports.
CONFIG_MCUMGR_SMP_BT=y
CONFIG_MCUMGR_SMP_BT_AUTHEN=n

# Disable Bluetooth unused features
CONFIG_BT_GATT_READ_MULTIPLE=n

# Disable statistics and statistic names.
CONFIG_STATS_NAMES=n
```

## src/main.c
```c
/*
 * Copyright (c) 2012-2014 Wind River Systems, Inc.
 * Copyright (c) 2020 Prevas A/S
 *
 * SPDX-License-Identifier: Apache-2.0
 */
#include <stdlib.h>
#include <zephyr.h>
#include <stats/stats.h>
#include <usb/usb_device.h>

#include <devicetree.h>
#include <drivers/gpio.h>

#ifdef CONFIG_MCUMGR_CMD_FS_MGMT
#include <device.h>
#include <fs/fs.h>
#include "fs_mgmt/fs_mgmt.h"
#include <fs/littlefs.h>
#endif
#ifdef CONFIG_MCUMGR_CMD_OS_MGMT
#include "os_mgmt/os_mgmt.h"
#endif
#ifdef CONFIG_MCUMGR_CMD_IMG_MGMT
#include "img_mgmt/img_mgmt.h"
#endif
#ifdef CONFIG_MCUMGR_CMD_STAT_MGMT
#include "stat_mgmt/stat_mgmt.h"
#endif

#define LOG_LEVEL LOG_LEVEL_DBG
#include <logging/log.h>

#include <shell/shell.h>
#include "config.h"
#include "motor.h"
#include "common.h"
#include "led.h"
#include "state_machine.h"

LOG_MODULE_REGISTER(main);


/* Define an example stats group; approximates seconds since boot. */
STATS_SECT_START(smp_svr_stats)
STATS_SECT_ENTRY(ticks)
STATS_SECT_END;

/* Assign a name to the `ticks` stat. */
STATS_NAME_START(smp_svr_stats)
STATS_NAME(smp_svr_stats, ticks)
STATS_NAME_END(smp_svr_stats);

/* Define an instance of the stats group. */
STATS_SECT_DECL(smp_svr_stats) smp_svr_stats;

#ifdef CONFIG_MCUMGR_CMD_FS_MGMT
FS_LITTLEFS_DECLARE_DEFAULT_CONFIG(cstorage);
static struct fs_mount_t littlefs_mnt = {
	.type = FS_LITTLEFS,
	.fs_data = &cstorage,
	.storage_dev = (void *)FLASH_AREA_ID(storage),
	.mnt_point = "/lfs"
};
#endif


void main(void)
{
	int ret;

	/* using __TIME__ ensure that a new binary will be built on every
	 * compile which is convient when testing firmware upgrade.
	 */
	LOG_INF("build time: " __DATE__ " " __TIME__);

	/* The system work queue handles all incoming mcumgr requests.  Let the
	 * main thread idle while the mcumgr server runs.
	 */
	ret = led_thread_init();
	if (ret) {
		LOG_ERR("led module not initialized. err:%d", ret);
	}

	ret = config_module_init();
	if (ret) {
		LOG_ERR("config_module error (err: %d)", ret);
	}

	ret = STATS_INIT_AND_REG(smp_svr_stats, STATS_SIZE_32,
	 			 "smp_svr_stats");

	if (ret < 0) {
		led_blink_slow(LED_RED, 2);
		LOG_ERR("Error initializing stats system [%d]", ret);
	}

	/* Register the built-in mcumgr command handlers. */
#ifdef CONFIG_MCUMGR_CMD_FS_MGMT
	ret = fs_mount(&littlefs_mnt);
	if (ret < 0) {
		led_blink_slow(LED_RED, 3);
		LOG_ERR("Error mounting littlefs [%d]", ret);
	}

	fs_mgmt_register_group();
#endif
#ifdef CONFIG_MCUMGR_CMD_OS_MGMT
	os_mgmt_register_group();
#endif
#ifdef CONFIG_MCUMGR_CMD_IMG_MGMT
	img_mgmt_register_group();
#endif
#ifdef CONFIG_MCUMGR_CMD_STAT_MGMT
	stat_mgmt_register_group();
#endif
#ifdef CONFIG_MCUMGR_SMP_BT
	start_smp_bluetooth();
#endif
#ifdef CONFIG_MCUMGR_SMP_UDP
	start_smp_udp();
#endif

	if (IS_ENABLED(CONFIG_USB)) {
		ret = usb_enable(NULL);
		if (ret) {
			led_blink_slow(LED_RED, 4);
			LOG_ERR("Failed to enable USB");
			return;
		}
	}

	ret = motor_init();
	if (ret) {
		LOG_ERR("motor init error (err: %d)", ret);
		led_blink_slow(LED_RED, LED_BLINK_INFINITE);
		return;
	}

	ret = state_machine_init();
	if (ret) {
		LOG_ERR("State machine init error (err: %d)", ret);
	}
}

static int cmd_konf_read(const struct shell *shell, size_t argc, char **argv)
{
	const uint32_t *speed = config_param_get(CONFIG_PARAM_SPEED_MAX);

	shell_print(shell, "new value = %d", *speed);

	return 0;
}

static int cmd_konf_write(const struct shell *shell, size_t argc, char **argv)
{
	int rc;
	uint32_t data;
	uint32_t param;

	param = (int)strtol(argv[1], NULL, 10);
	data = (int)strtol(argv[2], NULL, 10);

	rc = config_param_write(param, &data);

	shell_print(shell, "rc = %d", rc);
	return 0;
}

SHELL_STATIC_SUBCMD_SET_CREATE(sub_konf,
	SHELL_CMD(read, NULL, "Dictionary commands", cmd_konf_read),
	SHELL_CMD(write, NULL, "Hexdump params command.", cmd_konf_write),
	SHELL_SUBCMD_SET_END /* Array terminated. */
);
SHELL_CMD_ARG_REGISTER(konfig, &sub_konf, NULL, NULL, 2, 0);
```

## src/adc.c
```c
/*
 * Copyright (c) 2020 Jakub Rzeszutko
 *
 * SPDX-License-Identifier: Apache-2.0
 */

#include <stdlib.h>
#include <zephyr.h>
#include <devicetree.h>
#include <drivers/adc.h>
#include <drivers/gpio.h>
#define LOG_LEVEL LOG_LEVEL_DBG
#include <logging/log.h>

#include "adc.h"

LOG_MODULE_REGISTER(adc);

static int32_t buffer;

struct adc_device {
	const struct device *dev;
	struct adc_channel_cfg cfg;
	struct adc_sequence sequence;

};

static struct adc_device adc = {
	.dev = NULL,

	.cfg.gain = ADC_GAIN_1_4,
	.cfg.reference = ADC_REF_VDD_1_4,
	.cfg.acquisition_time = ADC_ACQ_TIME(ADC_ACQ_TIME_MICROSECONDS, 10),
	.cfg.channel_id = 0,
	.cfg.differential = 0,
	.cfg.input_positive = 1, // AIN0 -> ADC result: motor current
	.cfg.input_negative = 0,

	.sequence.options = NULL,
	.sequence.channels = BIT(0), // channel 0
	.sequence.buffer = &buffer,
	.sequence.buffer_size = sizeof(buffer),
	.sequence.resolution = 12,
};

int adc_init(void)
{
	int rc;

	adc.dev = device_get_binding(DT_LABEL(DT_NODELABEL(adc)));
	if (!adc.dev) {
		LOG_ERR("%s: Cannot get QDEC device", __FUNCTION__);
		return -ENXIO;
	}

	rc = adc_channel_setup(adc.dev, &adc.cfg);
	LOG_INF("channel setup: [%s]", rc != 0 ? "error" : "ok");
	if (rc) {
		return rc;
	}

	rc = adc_read(adc.dev, &adc.sequence);
	LOG_INF("channel read: [%s]", rc != 0 ? "error" : "ok");
	if (rc == 0) {
		LOG_INF(" -> Measured: %d", buffer);
	}

	return rc;
}

int adc_get(int32_t *result)
{
	int rc;

	rc = adc_read(adc.dev, &adc.sequence);
	*result = buffer;

	return rc;
}
```

## src/bluetooth.c
```c
/*
 * Copyright (c) 2012-2014 Wind River Systems, Inc.
 * Copyright (c) 2020 Prevas A/S
 * Copyright (c) 2020 Jakub Rzeszutko
 *
 * SPDX-License-Identifier: Apache-2.0
 */

#include <bluetooth/bluetooth.h>
#include <bluetooth/conn.h>
#include <bluetooth/gatt.h>
#include <mgmt/mcumgr/smp_bt.h>
#include "state_machine.h"

#include "led.h"
#include "config.h"

#define LOG_LEVEL LOG_LEVEL_DBG
#include <logging/log.h>
LOG_MODULE_REGISTER(bluetooth);

static struct k_work advertise_work;

static const struct bt_data ad[] = {
	BT_DATA_BYTES(BT_DATA_FLAGS, (BT_LE_AD_GENERAL | BT_LE_AD_NO_BREDR)),
	BT_DATA_BYTES(BT_DATA_UUID128_ALL,
		      0x84, 0xaa, 0x60, 0x74, 0x52, 0x8a, 0x8b, 0x86,
		      0xd3, 0x4c, 0xb7, 0x1d, 0x1d, 0xdc, 0x53, 0x8d),
};

static void advertise(struct k_work *work)
{
	int rc;

	bt_le_adv_stop();

	rc = bt_le_adv_start(BT_LE_ADV_CONN_NAME, ad, ARRAY_SIZE(ad), NULL, 0);
	if (rc) {
		LOG_ERR("Advertising failed to start (rc %d)", rc);
		return;
	}

	LOG_INF("Advertising successfully started");
}

static void connected(struct bt_conn *conn, uint8_t err)
{
	char addr[BT_ADDR_LE_STR_LEN];

	bt_addr_le_to_str(bt_conn_get_dst(conn), addr, sizeof(addr));

	if (err) {
		LOG_INF("Failed to connect to %s (%u)\n", addr, err);
		return;
	}

	LOG_INF("Connected %s\n", addr);

	led_blink_slow(LED_BLUE, 3);

	if (bt_conn_set_security(conn, BT_SECURITY_L4)) {
		LOG_INF("Failed to set security\n");
	}
}

static void disconnected(struct bt_conn *conn, uint8_t reason)
{
	char addr[BT_ADDR_LE_STR_LEN];

	bt_addr_le_to_str(bt_conn_get_dst(conn), addr, sizeof(addr));

	LOG_INF("Disconnected (reason 0x%02x)", reason);
	k_work_submit(&advertise_work);
}

static void security_changed(struct bt_conn *conn, bt_security_t level,
			     enum bt_security_err err)
{
	char addr[BT_ADDR_LE_STR_LEN];

	bt_addr_le_to_str(bt_conn_get_dst(conn), addr, sizeof(addr));

	if (!err) {
		LOG_INF("Security changed: %s level %u\n", addr, level);
	} else {
		LOG_INF("Security failed: %s level %u err %d\n", addr, level,
			err);
	}
}

static void auth_passkey_display(struct bt_conn *conn, unsigned int passkey)
{
	char addr[BT_ADDR_LE_STR_LEN];

	bt_addr_le_to_str(bt_conn_get_dst(conn), addr, sizeof(addr));

	LOG_INF("Passkey for %s: %06u\n", addr, passkey);
}

static struct bt_conn_cb conn_callbacks = {
	.connected = connected,
	.disconnected = disconnected,
	.security_changed = security_changed,
};

static void auth_cancel(struct bt_conn *conn)
{
	char addr[BT_ADDR_LE_STR_LEN];

	bt_addr_le_to_str(bt_conn_get_dst(conn), addr, sizeof(addr));

	LOG_INF("Pairing cancelled: %s\n", addr);
}

static struct bt_conn_auth_cb auth_cb_display = {
	.passkey_display = auth_passkey_display,
	.passkey_entry = NULL,
	.cancel = auth_cancel,
};

static void bt_ready(int err)
{
	if (err) {
		LOG_ERR("Bluetooth init failed (err %d)", err);
		return;
	}

	LOG_INF("Bluetooth initialized");

	k_work_submit(&advertise_work);
}

void start_smp_bluetooth(void)
{
	const uint32_t *key;

	k_work_init(&advertise_work, advertise);

	key = config_param_get(CONFIG_PARAM_BT_AUTH_PSWD);

	if (key == NULL) {
		LOG_ERR("%s: cannot get config key", __FUNCTION__);
		return;
	}

	bt_passkey_set(*key);

	/* Enable Bluetooth. */
	int rc = bt_enable(bt_ready);

	if (rc != 0) {
		LOG_ERR("Bluetooth init failed (err %d)", rc);
		return;
	}
	bt_conn_cb_register(&conn_callbacks);
	bt_conn_auth_cb_register(&auth_cb_display);

	/* Initialize the Bluetooth mcumgr transport. */
	smp_bt_register();
}
```

## src/buttons.c
```c
/*
 * Copyright (c) 2020 Jakub Rzeszutko
 *
 * SPDX-License-Identifier: Apache-2.0
 */

#include <stdlib.h>
#include <zephyr.h>
#include <devicetree.h>
#include <drivers/gpio.h>

#define LOG_LEVEL LOG_LEVEL_DBG
#include <logging/log.h>

#include "buttons.h"

#define BUTTON_SPEED_NODE	DT_ALIAS(button_speed)
#if DT_NODE_HAS_STATUS(BUTTON_SPEED_NODE, okay)
#define BUTTON_SPEED_LABEL	DT_GPIO_LABEL(BUTTON_SPEED_NODE, gpios)
#define BUTTON_SPEED_PIN	DT_GPIO_PIN(BUTTON_SPEED_NODE, gpios)
#define BUTTON_SPEED_FLAGS	DT_GPIO_FLAGS(BUTTON_SPEED_NODE, gpios)
#else
#error "Unsupported board: BUTTON_SPEED devicetree alias not found"
#endif

#define BUTTON_CALL_NODE	DT_ALIAS(button_call)
#if DT_NODE_HAS_STATUS(BUTTON_CALL_NODE, okay)
#define BUTTON_CALL_LABEL	DT_GPIO_LABEL(BUTTON_CALL_NODE, gpios)
#define BUTTON_CALL_PIN		DT_GPIO_PIN(BUTTON_CALL_NODE, gpios)
#define BUTTON_CALL_FLAGS	DT_GPIO_FLAGS(BUTTON_CALL_NODE, gpios)
#else
#error "Unsupported board: BUTTON_CALL devicetree alias not found"
#endif

#define BUTTON_PRESS_SAMPLING_MS	20u
#define BUTTON_DELAY_WORK_SAMPLING	K_MSEC(BUTTON_PRESS_SAMPLING_MS)
#define BUTTON_PRESS_SHORT_MS		20u
#define BUTTON_PRESS_LONG_MS		1000u
#define BUTTON_PRESS_STUCK_MS		90000u

#define BUTTON_PRESS_SHORT_CNT	(BUTTON_PRESS_SHORT_MS/BUTTON_PRESS_SAMPLING_MS)
#define BUTTON_PRESS_LONG_CNT	(BUTTON_PRESS_LONG_MS/BUTTON_PRESS_SAMPLING_MS)
#define BUTTON_PRESS_STUCTK_CNT	(BUTTON_PRESS_STUCK_MS/BUTTON_PRESS_SAMPLING_MS)

LOG_MODULE_REGISTER(button);

enum button_state {
	BUTTON_STATE_IDLE,
	BUTTON_STATE_PRESSED,
	BUTTON_STATE_VALID_SHORT,
	BUTTON_STATE_VALID_LONG,
	BUTTON_STATE_STUCKED,
};

struct button_dev {
	struct k_delayed_work work;

	const struct device *dev;
	gpio_pin_t pin;

	uint16_t cnt;
};

static struct gpio_callback button_speed_cb_data;
static struct gpio_callback button_call_cb_data;
static struct button_dev button_dev[BUTTON_NAME_MAX];
static button_hander_t app_notify_cb;

static void button_speed_pressed(const struct device *dev,
				 struct gpio_callback *cb,
				 uint32_t pins)
{
//	button_enable(BUTTON_NAME_SPEED, false); // disable interrupt
	button_dev[BUTTON_NAME_SPEED].cnt = 0;
	/* start filtering process */
	k_delayed_work_submit(&button_dev[BUTTON_NAME_SPEED].work,
			      BUTTON_DELAY_WORK_SAMPLING);
}

static void button_call_pressed(const struct device *dev,
				struct gpio_callback *cb,
				uint32_t pins)
{
//	button_enable(BUTTON_NAME_CALL, false); // disable interrupt
	LOG_INF("%s", __FUNCTION__);
	button_dev[BUTTON_NAME_CALL].cnt = 0;
	/* start filtering process */
	k_delayed_work_submit(&button_dev[BUTTON_NAME_CALL].work,
			      BUTTON_DELAY_WORK_SAMPLING);
}

/* Function for validating button speed */
static void button_speed_filter(struct k_work *work)
{
	int state;

//	button_enable(BUTTON_NAME_SPEED, true);
	state = gpio_pin_get(button_dev[BUTTON_NAME_SPEED].dev,
			     button_dev[BUTTON_NAME_SPEED].pin);

	/* gpio_pin_get returns true if button is pressed */
	if (state) {
		button_dev[BUTTON_NAME_SPEED].cnt++;
		k_delayed_work_submit(&button_dev[BUTTON_NAME_SPEED].work,
				      BUTTON_DELAY_WORK_SAMPLING);
		return;
	}

	/* In case button is valid or stucked, interrupts must be enabled again
	 * by the main app.
	 */
	if (button_dev[BUTTON_NAME_SPEED].cnt < BUTTON_PRESS_SHORT_CNT) {
		/* Reject due to too short press */
		return;
	}

	button_enable(BUTTON_NAME_SPEED, false);

	if (button_dev[BUTTON_NAME_SPEED].cnt < BUTTON_PRESS_LONG_CNT) {
		app_notify_cb(BUTTON_NAME_SPEED, BUTTON_EVT_PRESSED_SHORT);
	} else if (button_dev[BUTTON_NAME_SPEED].cnt < BUTTON_PRESS_STUCTK_CNT) {
		app_notify_cb(BUTTON_NAME_SPEED, BUTTON_EVT_PRESSED_LONG);
	} else {
		app_notify_cb(BUTTON_NAME_SPEED, BUTTON_EVT_STUCKED);
	}
}

static void button_call_filter(struct k_work *work)
{
	int state;

//	button_enable(BUTTON_NAME_CALL, true);
	state = gpio_pin_get(button_dev[BUTTON_NAME_CALL].dev,
			     button_dev[BUTTON_NAME_CALL].pin);

	/* gpio_pin_get returns true if button is pressed */
	if (state) {
		button_dev[BUTTON_NAME_CALL].cnt++;
		k_delayed_work_submit(&button_dev[BUTTON_NAME_CALL].work,
				      BUTTON_DELAY_WORK_SAMPLING);
		return;
	}

	/* In case button is valid or stucked, interrupts must be enabled again
	 * by the main app.
	 * If the press is shorter than short press interrupts will be resumed
	 */
	if (button_dev[BUTTON_NAME_CALL].cnt < BUTTON_PRESS_SHORT_CNT) {
		/* Reject due to too short press */
		return;
	}

	button_enable(BUTTON_NAME_CALL, false);

	if (button_dev[BUTTON_NAME_CALL].cnt < BUTTON_PRESS_LONG_CNT) {
		app_notify_cb(BUTTON_NAME_CALL, BUTTON_EVT_PRESSED_SHORT);
	} else if (button_dev[BUTTON_NAME_CALL].cnt < BUTTON_PRESS_STUCTK_CNT) {
		app_notify_cb(BUTTON_NAME_CALL, BUTTON_EVT_PRESSED_LONG);
	} else {
		app_notify_cb(BUTTON_NAME_CALL, BUTTON_EVT_STUCKED);
	}
}

int buttons_init(button_hander_t button_cb)
{
	int ret;

	if (button_cb == NULL) {
		LOG_WRN("%s: missing callback", __FUNCTION__);
		return -EINVAL;
	}
	app_notify_cb = button_cb;

	button_dev[BUTTON_NAME_SPEED].dev = device_get_binding(BUTTON_SPEED_LABEL);
	button_dev[BUTTON_NAME_SPEED].pin = BUTTON_SPEED_PIN;
	button_dev[BUTTON_NAME_CALL].dev = device_get_binding(BUTTON_CALL_LABEL);
	button_dev[BUTTON_NAME_CALL].pin = BUTTON_CALL_PIN;

	ret = gpio_pin_configure(button_dev[BUTTON_NAME_SPEED].dev,
				 button_dev[BUTTON_NAME_SPEED].pin,
				 BUTTON_SPEED_FLAGS);
	if (ret) {
		LOG_ERR("%s: BUTTON SPEED init error: [%d]", __FUNCTION__, ret);
		return ret;
	}

	ret = gpio_pin_configure(button_dev[BUTTON_NAME_CALL].dev,
				 button_dev[BUTTON_NAME_CALL].pin,
				 BUTTON_CALL_FLAGS);
	if (ret) {
		LOG_ERR("%s: BUTTON CALL init error: [%d]", __FUNCTION__, ret);
		return ret;
	}

	ret = gpio_pin_interrupt_configure(button_dev[BUTTON_NAME_SPEED].dev,
					   button_dev[BUTTON_NAME_SPEED].pin,
					   GPIO_INT_DISABLE);
	if (ret) {
		LOG_WRN("%s: button speed irq init err: [%d]", __FUNCTION__,
			ret);
		return ret;
	}
	gpio_init_callback(&button_speed_cb_data,
			   button_speed_pressed,
			   BIT(BUTTON_SPEED_PIN));
	gpio_add_callback(button_dev[BUTTON_NAME_SPEED].dev,
			  &button_speed_cb_data);

	ret = gpio_pin_interrupt_configure(button_dev[BUTTON_NAME_CALL].dev,
					   button_dev[BUTTON_NAME_CALL].pin,
					   GPIO_INT_DISABLE);
	if (ret) {
		LOG_WRN("%s: button call irq init err: [%d]", __FUNCTION__,
			ret);
		return ret;
	}
	gpio_init_callback(&button_call_cb_data,
			   button_call_pressed,
			   BIT(BUTTON_CALL_PIN));
	gpio_add_callback(button_dev[BUTTON_NAME_CALL].dev,
			  &button_call_cb_data);

	k_delayed_work_init(&button_dev[BUTTON_NAME_SPEED].work,
			    button_speed_filter);

	k_delayed_work_init(&button_dev[BUTTON_NAME_CALL].work,
			    button_call_filter);

	return 0;
}

/* enable button interrupt */
int button_enable(enum button_name name, bool enable)
{
	int ret;
	gpio_flags_t flags;

	if (name >= BUTTON_NAME_MAX) {
		LOG_WRN("%s: bad name:[%d]", __FUNCTION__, name);
		return -EINVAL;
	}

	flags = enable ? GPIO_INT_EDGE_TO_ACTIVE : GPIO_INT_DISABLE;
	ret = gpio_pin_interrupt_configure(button_dev[name].dev,
					   button_dev[name].pin, flags);
	if (ret) {
		LOG_WRN("%s: button [%d] %s failed: %d", __FUNCTION__,
			name, enable ? "enable" : "disable", ret);
	}

	return ret;
}

int buttons_enable(bool enable)
{
	int ret;

	ret = button_enable(BUTTON_NAME_SPEED, enable);
	if (ret) {
		return ret;
	}

	ret = button_enable(BUTTON_NAME_CALL, enable);

	return ret;
}
```

## src/config.c
```c
#include <stdbool.h>
#include <zephyr.h>
#include <sys/crc.h>
#include <settings/settings.h>
#include <shell/shell.h>

#include <logging/log.h>
LOG_MODULE_REGISTER(config_module);

#include "config.h"

/* CRC16 polynomial */
#define POLYNOMIAL 0x8005

struct device_cfg {
	uint32_t speed_max;
	uint32_t speed_min;
	uint32_t distance_min;
	uint32_t distance_brake;
	uint32_t pid_kp;
	uint32_t pid_ki;
	uint32_t bt_pswd;
};


static struct device_cfg device_cfg;
static bool initialized;
static uint32_t crc;

static int cfg_handle_set(const char *name, size_t len,
			  settings_read_cb read_cb, void *cb_arg)
{
	struct device_cfg *p = &device_cfg;
	const char *next;
	size_t name_len;
	int rc;

	name_len = settings_name_next(name, &next);

	if (!next) {
		if (!strncmp(name, "speed_max", name_len)) {
			rc = read_cb(cb_arg, &p->speed_max,
				     sizeof(p->speed_max));
			return 0;
		}
		if (!strncmp(name, "speed_min", name_len)) {
			rc = read_cb(cb_arg, &p->speed_min,
				     sizeof(p->speed_min));
			return 0;
		}
		if (!strncmp(name, "distance_min", name_len)) {
			rc = read_cb(cb_arg, &p->distance_min,
				     sizeof(p->distance_min));
			return 0;
		}
		if (!strncmp(name, "distance_brake", name_len)) {
			rc = read_cb(cb_arg, &p->distance_brake,
				     sizeof(p->distance_brake));
			return 0;
		}
		if (!strncmp(name, "pid_kp", name_len)) {
			rc = read_cb(cb_arg, &p->pid_kp, sizeof(p->pid_kp));
			return 0;
		}
		if (!strncmp(name, "pid_ki", name_len)) {
			rc = read_cb(cb_arg, &p->pid_ki, sizeof(p->pid_ki));
			return 0;
		}
		if (!strncmp(name, "bt_pswd", name_len)) {
			rc = read_cb(cb_arg, &p->bt_pswd, sizeof(p->bt_pswd));
			return 0;
		}
		if (!strncmp(name, "crc", name_len)) {
			rc = read_cb(cb_arg, &crc, sizeof(crc));
			return 0;
		}
        return 0;
	}

	return -ENOENT;
}

static int cfg_handle_export(int (*cb)(const char *name,
			       const void *value, size_t val_len))
{
	const struct device_cfg *p = &device_cfg;

	LOG_INF("export keys under <CFG> handler");

	(void)cb("engine/cfg/speed_max", &p->speed_max, sizeof(p->speed_max));
	(void)cb("engine/cfg/speed_min", &p->speed_min, sizeof(p->speed_min));
	(void)cb("engine/cfg/distance_min", &p->distance_min,
		 sizeof(p->distance_min));
	(void)cb("engine/cfg/distance_brake", &p->distance_brake,
		 sizeof(p->distance_brake));
	(void)cb("engine/cfg/pid_kp", &p->pid_kp, sizeof(p->pid_kp));
	(void)cb("engine/cfg/pid_ki", &p->pid_ki, sizeof(p->pid_ki));
	(void)cb("engine/cfg/bt_pswd", &p->bt_pswd, sizeof(p->bt_pswd));
	(void)cb("engine/cfg/crc", &crc, sizeof(crc));

	return 0;
}

static int cfg_handle_commit(void)
{
	LOG_INF("loading all settings under <cfg> handler is done");
	return 0;
}

static int cfg_handle_get(const char *name, char *val, int val_len_max)
{
	return -ENOENT;
}

/* static subtree handler */
SETTINGS_STATIC_HANDLER_DEFINE(cfg, "engine/cfg", cfg_handle_get,
			       cfg_handle_set, cfg_handle_commit,
			       cfg_handle_export);

int config_module_init(void)
{
	int rc;
	uint16_t calc_crc;
	const uint8_t *ptr;

	rc = settings_subsys_init();
	if (rc != 0) {
		LOG_ERR("Initialization: fail (err %d)", rc);
		goto default_settings;
	}

	rc = settings_load();

	if (rc != 0) {
		LOG_ERR("Settings load fail (err %d)", rc);
		goto default_settings;
	}

	ptr = (const uint8_t *)&device_cfg;
	calc_crc = crc16(ptr, sizeof(device_cfg), POLYNOMIAL, 0, 0);
	LOG_INF("CRC Settings: [%s]", crc == calc_crc ? "ok" : "not ok");
	if (calc_crc == crc) {
		initialized = true;
		return rc;
	}

default_settings:
	config_make_default_settings();

	initialized = true;

	return rc;
}

int config_param_write(enum config_param_type type, const void *const data)
{
	struct device_cfg *p = &device_cfg;
	int rc;

	if (!initialized) {
		return -EACCES;
	}

	if (!data) {
		LOG_INF("data is NULL pointer");
		return -EINVAL;
	}
	switch (type) {
	case CONFIG_PARAM_SPEED_MAX:
		p->speed_max = *((uint32_t *)data);
		rc = settings_save_one("engine/cfg/speed_max",
					(const void *)data,
					sizeof(uint32_t));
		LOG_INF("writing speed_max: %d", rc);
		break;
	case CONFIG_PARAM_SPEED_MIN:
		p->speed_min = *((uint32_t *)data);
		rc = settings_save_one("engine/cfg/speed_min",
					(const void *)data,
					sizeof(uint32_t));
		LOG_INF("writing speed_min: %d", rc);
		break;
	case CONFIG_PARAM_DISTANCE_MIN:
		p->distance_min = *((uint32_t *)data);
		rc = settings_save_one("engine/cfg/distance_min",
					(const void *)data,
					sizeof(uint32_t));
		LOG_INF("writing distance_min: %d", rc);
		break;
	case CONFIG_PARAM_DISTANCE_BRAKE:
		p->distance_brake = *((uint32_t *)data);
		rc = settings_save_one("engine/cfg/distance_brake",
					(const void *)data,
					sizeof(uint32_t));
		LOG_INF("writing distance_brake: %d", rc);
		break;
	case CONFIG_PARAM_PID_KP:
		p->pid_kp = *((uint32_t *)data);
		rc = settings_save_one("engine/cfg/pid_kp",
					(const void *)data,
					sizeof(uint32_t));
		LOG_INF("writing pid_kp: %d", rc);
		break;
	case CONFIG_PARAM_PID_KI:
		p->pid_ki = *((uint32_t *)data);
		rc = settings_save_one("engine/cfg/pid_ki",
					(const void *)data,
					sizeof(uint32_t));
		LOG_INF("writing pid_ki: %d", rc);
		break;
	case CONFIG_PARAM_BT_AUTH_PSWD:
		p->bt_pswd = *((uint32_t *)data);
		rc = settings_save_one("engine/cfg/bt_pswd",
					(const void *)data,
					sizeof(uint32_t));
		LOG_INF("writing bt_pswd: %d", rc);
		break;
	case CONFIG_CHECKSUM:
		crc = *((uint32_t *)data);
		rc = settings_save_one("engine/cfg/crc",
					(const void *)data,
					sizeof(uint32_t));
		LOG_INF("writing crc: %d", rc);
		break;
	default:
		LOG_INF("type is not valid");
		return -EINVAL;
	}

	return rc;
}

const void *config_param_get(enum config_param_type type)
{
	const struct device_cfg *p = &device_cfg;

	if (!initialized) {
		return NULL;
	}

	switch (type) {
	case CONFIG_PARAM_SPEED_MAX:
		return &p->speed_max;
	case CONFIG_PARAM_SPEED_MIN:
		return &p->speed_min;
	case CONFIG_PARAM_DISTANCE_MIN:
		return &p->distance_min;
	case CONFIG_PARAM_DISTANCE_BRAKE:
		return &p->distance_brake;
	case CONFIG_PARAM_PID_KP:
		return &p->pid_kp;
	case CONFIG_PARAM_PID_KI:
		return &p->pid_ki;
	case CONFIG_PARAM_BT_AUTH_PSWD:
		return &p->bt_pswd;
	case CONFIG_CHECKSUM:
		return &crc;
	default:
		break;
	}

	LOG_INF("%s: Uknown parameter type", __FUNCTION__);
	return NULL;
}

void config_print_params(void)
{
	const struct device_cfg *p = &device_cfg;
	LOG_INF("Device configuration:\n\r"
		" speed_max = %d\n\r speed_min = %d\n\r distance_min = %d\n\r"
		" distance_brake = %d\n\r pid_kp = %d\n\r pid_ki = %d\n\r",
		p->speed_max, p->speed_min, p->distance_min,
		p->distance_brake, p->pid_kp, p->pid_ki);

}

int config_make_default_settings(void)
{
	const uint8_t *ptr;
	int rc;

	device_cfg.speed_max = CONFIG_DEFAULT_SPEED_MAX;
	device_cfg.speed_min = CONFIG_DEFAULT_SPEED_MIN;
	device_cfg.distance_min = CONFIG_DEFAULT_DISTANCE_MIN;
	device_cfg.distance_brake = CONFIG_DEFAULT_DISTANCE_BRAKE;
	device_cfg.pid_kp = CONFIG_DEFAULT_PID_KP;
	device_cfg.pid_ki = CONFIG_DEFAULT_PID_KI;
	device_cfg.bt_pswd = 253678;

	ptr = (const uint8_t *)&device_cfg;
	crc = crc16(ptr, sizeof(device_cfg), POLYNOMIAL, 0, 0);

	LOG_INF("Device will operate with default settings");

	rc = settings_save();

	if (rc) {
		LOG_INF("Cannot save default config in flash");
	} else {
		LOG_INF("Default settings saved");
	}

	return rc;
}


static int cmd_conf_reset(const struct shell *shell, size_t argc, char **argv)
{
	int rc;

	(void)argc;
	(void)argv;

	rc = config_make_default_settings();
	if (rc) {
		shell_error(shell, "config module error: %d", rc);
	} else {
		shell_print(shell, "default config applied");
	}

	return 0;
}

static int cmd_conf_show(const struct shell *shell, size_t argc, char **argv)
{
	(void)argc;
	(void)argv;

	config_print_params();
	return 0;
}

SHELL_STATIC_SUBCMD_SET_CREATE(sub_conf,
	SHELL_CMD(reset, NULL, "Default config", cmd_conf_reset),
	SHELL_CMD(show, NULL, "Show config", cmd_conf_show),
	SHELL_SUBCMD_SET_END /* Array terminated. */
);
SHELL_CMD_ARG_REGISTER(config, &sub_conf, NULL, NULL, 2, 0);
```

## src/config.h
```c
enum config_param_type {
	CONFIG_PARAM_SPEED_MAX,
	CONFIG_PARAM_SPEED_MIN,
	CONFIG_PARAM_DISTANCE_MIN,
	CONFIG_PARAM_MAX,
};

int config_module_init(void);
int config_param_write(enum config_param_type type, const void *data);
const void *config_param_get(enum config_param_type type);
```

## src/encoder.c
```c
/*
 * Copyright (c) 2020 Jakub Rzeszutko
 *
 * SPDX-License-Identifier: Apache-2.0
 */

#include <stdlib.h>
#include <zephyr.h>
#include <devicetree.h>
#include <drivers/gpio.h>
#include <drivers/sensor.h>
#include <shell/shell.h>
#define LOG_LEVEL LOG_LEVEL_DBG
#include <logging/log.h>

#include "encoder.h"

LOG_MODULE_REGISTER(encoder);

static const struct device *qdec_dev;

static const struct sensor_trigger qdec_trig = {
	.type = SENSOR_TRIG_DATA_READY,
	.chan = SENSOR_CHAN_ROTATION,
};

static struct encoder_result qdec_data;

static int qdec_init(void)
{
	qdec_dev = device_get_binding(DT_LABEL(DT_NODELABEL(qdec)));
	if (!qdec_dev) {
		LOG_ERR("%s: Cannot get QDEC device", __FUNCTION__);
		return -ENXIO;
	}

	return 0;
}

static void data_ready_handler(const struct device *dev,
			       struct sensor_trigger *trig)
{
	struct sensor_value value;

	int err = sensor_channel_get(qdec_dev, SENSOR_CHAN_ROTATION, &value);
	if (err) {
		LOG_ERR("%s: Cannot get sensor value", __FUNCTION__);
		return;
	}

	qdec_data.acc += value.val1;
	qdec_data.accdbl += value.val2;
}

int encoder_init(bool trigger)
{
	struct sensor_value val;
	int ret;

	qdec_data.acc = 0;
	qdec_data.accdbl = 0;

	qdec_init();
	(void)sensor_sample_fetch(qdec_dev);
	(void)sensor_channel_get(qdec_dev, SENSOR_CHAN_ROTATION, &val);

	if (trigger) {
		ret = sensor_trigger_set(qdec_dev,
					 (struct sensor_trigger *)&qdec_trig,
					 data_ready_handler);
	}

	return 0;
}

int encoder_get(struct encoder_result *data)
{
	int ret;
	struct sensor_value val;

	if (!qdec_dev) {
		LOG_ERR("%s: Cannot get QDEC device", __FUNCTION__);
		return -ENXIO;
	}

	ret = sensor_sample_fetch(qdec_dev);
	if (ret) {
		LOG_WRN("%s: cannot fetch sample. Err: [%d]", __FUNCTION__,
			ret);
		return ret;
	}

	ret = sensor_channel_get(qdec_dev, SENSOR_CHAN_ROTATION, &val);

	int key = irq_lock();
	qdec_data.acc += val.val1;
	qdec_data.accdbl += val.val2;
	irq_unlock(key);

	data->acc = qdec_data.acc;
	data->accdbl = qdec_data.accdbl;

	qdec_data.acc = 0;
	qdec_data.accdbl = 0;

	return ret;
}

static int cmd_enc_acc(const struct shell *shell, size_t argc, char **argv)
{
	shell_print(shell, "acc = %d | accdbl = %d",
		    qdec_data.acc, qdec_data.accdbl);

	return 0;
}

static int cmd_enc_fetch(const struct shell *shell, size_t argc, char **argv)
{
	struct sensor_value val;

	(void)sensor_sample_fetch(qdec_dev);
	(void)sensor_channel_get(qdec_dev, SENSOR_CHAN_ROTATION, &val);

	shell_print(shell, "acc = %d | accdbl = %d", val.val1, val.val2);

	return 0;
}

SHELL_STATIC_SUBCMD_SET_CREATE(sub_encoder,
	SHELL_CMD(acc, NULL, "Hexdump params command.", cmd_enc_acc),
	SHELL_CMD(fetch, NULL, "Hexdump params command.", cmd_enc_fetch),
	SHELL_SUBCMD_SET_END /* Array terminated. */
);
SHELL_CMD_REGISTER(encoder, &sub_encoder, NULL, NULL);
```

## src/led.c
```c
/*
 * Copyright (c) 2020 Jakub Rzeszutko
 *
 * SPDX-License-Identifier: Apache-2.0
 */

#include <stdlib.h>
#include <zephyr.h>
#include <devicetree.h>
#include <drivers/gpio.h>

#define LOG_LEVEL LOG_LEVEL_DBG
#include <logging/log.h>

#include "led.h"

#define LED_GREEN_NODE	DT_ALIAS(led_green)
#if DT_NODE_HAS_STATUS(LED_GREEN_NODE, okay)
#define LED_GREEN_LABEL	DT_GPIO_LABEL(LED_GREEN_NODE, gpios)
#define LED_GREEN_PIN	DT_GPIO_PIN(LED_GREEN_NODE, gpios)
#define LED_GREEN_FLAGS	DT_GPIO_FLAGS(LED_GREEN_NODE, gpios)
#else
#error "Unsupported board: LED_GREEN devicetree alias not found"
#endif

#define LED_RED_NODE	DT_ALIAS(led_red)
#if DT_NODE_HAS_STATUS(LED_RED_NODE, okay)
#define LED_RED_LABEL	DT_GPIO_LABEL(LED_RED_NODE, gpios)
#define LED_RED_PIN	DT_GPIO_PIN(LED_RED_NODE, gpios)
#define LED_RED_FLAGS	DT_GPIO_FLAGS(LED_RED_NODE, gpios)
#else
#error "Unsupported board: LED_RED devicetree alias not found"
#endif

#define LED_BLUE_NODE	DT_ALIAS(led_blue)
#if DT_NODE_HAS_STATUS(LED_BLUE_NODE, okay)
#define LED_BLUE_LABEL	DT_GPIO_LABEL(LED_BLUE_NODE, gpios)
#define LED_BLUE_PIN	DT_GPIO_PIN(LED_BLUE_NODE, gpios)
#define LED_BLUE_FLAGS	DT_GPIO_FLAGS(LED_BLUE_NODE, gpios)
#else
#error "Unsupported board: LED_BLUE devicetree alias not found"
#endif

LOG_MODULE_REGISTER(led);

#define MAX_LED_EVENTS_IN_FIFO	3

#define THREAD_STACK_SIZE	2048
#define THREAD_PRIORITY		K_PRIO_PREEMPT(1)

K_FIFO_DEFINE(led_fifo);
static K_THREAD_STACK_DEFINE(thread_stack, THREAD_STACK_SIZE);
static struct k_thread thread;


enum led_action {
	LED_ACTION_OFF,
	LED_ACTION_ON,
	LED_ACTION_BLINK_FAST,
	LED_ACTION_BLINK_SLOW,
	LED_ACTION_MAX,
};

struct led_dev {
	const struct device *dev;
	gpio_pin_t pin;
};

struct led_obj {
	void *fifo_reserved; /* 1st word reserved for use by fifo */

	const struct led_dev *led;
	enum led_action action;
	uint32_t value;
	bool pin_state;
};

static volatile uint8_t action_cnt;
static struct led_dev led_dev[LED_MAX];

static int led_init(void)
{
	int ret;

	led_dev[LED_GREEN].dev = device_get_binding(LED_GREEN_LABEL);
	led_dev[LED_GREEN].pin = LED_GREEN_PIN;
	led_dev[LED_RED].dev = device_get_binding(LED_RED_LABEL);
	led_dev[LED_RED].pin = LED_RED_PIN;
	led_dev[LED_BLUE].dev = device_get_binding(LED_BLUE_LABEL);
	led_dev[LED_BLUE].pin = LED_BLUE_PIN;

	ret = gpio_pin_configure(led_dev[LED_GREEN].dev, led_dev[LED_GREEN].pin,
				 GPIO_OUTPUT_INACTIVE | LED_GREEN_FLAGS);
	if (ret) {
		LOG_ERR("%s: LED green init error: [%d]", __FUNCTION__, ret);
		return ret;
	}

	ret = gpio_pin_configure(led_dev[LED_RED].dev, led_dev[LED_RED].pin,
				 GPIO_OUTPUT_INACTIVE | LED_RED_FLAGS);
	if (ret) {
		LOG_ERR("%s: LED red init error: [%d]", __FUNCTION__, ret);
		return ret;
	}

	ret = gpio_pin_configure(led_dev[LED_BLUE].dev, led_dev[LED_BLUE].pin,
				 GPIO_OUTPUT_INACTIVE | LED_BLUE_FLAGS);
	if (ret) {
		LOG_ERR("%s: LED blue init error: [%d]", __FUNCTION__, ret);
		return ret;
	}

	return 0;
}

static void event_poll(struct led_obj **obj)
{
	int key = irq_lock();

	if (k_fifo_is_empty(&led_fifo)) {
		*obj = NULL;
		irq_unlock(key);
		return;
	}

	*obj = k_fifo_get(&led_fifo, K_NO_WAIT);
	irq_unlock(key);

	LOG_INF("%s: action: %d cnt: %d", __FUNCTION__,
		(*obj)->action, (*obj)->value);
}

static void event_start(struct led_obj *obj)
{
	int ret;

	if (obj->action == LED_ACTION_OFF) {
		obj->pin_state = false;
	} else {
		obj->pin_state = true;
	}

	ret = gpio_pin_set(obj->led->dev, obj->led->pin, (int)obj->pin_state);
	if (ret) {
		LOG_WRN("%s: failed: %d", __FUNCTION__, obj->action);
	}
}

static void event_finish(struct led_obj **obj)
{
	int ret;

	ret = gpio_pin_set((*obj)->led->dev, (*obj)->led->pin, false);
	if (ret) {
		LOG_WRN("%s: failed: [%d]", __FUNCTION__, ret);
	}

	int key = irq_lock();
	--action_cnt;
	k_free(*obj);
	*obj = NULL;
	irq_unlock(key);
}

static void led_thread_fn(void)
{
	static struct led_obj *active_obj = NULL;

	while(1) {
		k_sleep(K_MSEC(100));

		if (active_obj == NULL) {
			event_poll(&active_obj);
			if (active_obj) {
				event_start(active_obj);
			}
			continue;
		}

		switch (active_obj->action) {
		case LED_ACTION_OFF:
			event_finish(&active_obj); // led on = false
			break;
		case LED_ACTION_ON:
			if (!k_fifo_is_empty(&led_fifo)) {
				event_finish(&active_obj); // led on == true
			}
			break;
		case LED_ACTION_BLINK_SLOW:
			k_sleep(K_MSEC(400));
			__fallthrough;
		case LED_ACTION_BLINK_FAST:
			if (active_obj->value == LED_BLINK_INFINITE) {
				if (!k_fifo_is_empty(&led_fifo)) {
					active_obj->value = 1;
				}
			}
			active_obj->pin_state = !active_obj->pin_state;
			gpio_pin_set(active_obj->led->dev, active_obj->led->pin,
				     (int)active_obj->pin_state);

			if (!active_obj->pin_state) {
				active_obj->value--;
				if (active_obj->value == 0) {
					event_finish(&active_obj);
				}
			}
			break;
		default:
			event_finish(&active_obj);
			break;
		}
	}
}

static struct led_obj *get_led_obj(void)
{
	int key;

	key = irq_lock();

	if (action_cnt >= MAX_LED_EVENTS_IN_FIFO) {
		irq_unlock(key);
		LOG_WRN("%s: fifo full failed", __FUNCTION__);
		return NULL;
	}

	action_cnt++;
	irq_unlock(key);

	size_t size = sizeof(struct led_obj);
	struct led_obj *ptr = (struct led_obj *)k_malloc(size);

	if (ptr == NULL) {
		LOG_WRN("%s: malloc failed", __FUNCTION__);
		return NULL;
	}

	return ptr;
}

static int led_blink(enum led_color color, uint8_t cnt, enum led_action action)
{
	struct led_obj *ptr;

	if (cnt == 0) {
		return -EINVAL;
	}

	if (color >= LED_MAX) {
		return -EINVAL;
	}

	ptr = get_led_obj();
	if (ptr == NULL) {
		return -ENOMEM;
	}

	ptr->led = &led_dev[color];
	ptr->action = action;
	ptr->value = cnt;
	ptr->pin_state = false;
	k_fifo_put(&led_fifo, ptr);

	return 0;
}

int led_thread_init(void)
{
	int ret = led_init();

	LOG_INF("LED module initialization: [%s]", ret == 0 ? "OK" : "FAILED");
	if (ret != 0) {
		return ret;
	}

	k_thread_create(&thread, thread_stack,
			THREAD_STACK_SIZE,
			(k_thread_entry_t) led_thread_fn,
			NULL, NULL, NULL, THREAD_PRIORITY, 0, K_NO_WAIT);
	k_thread_name_set(&thread, "led_thread");

	return 0;
}

int led_set(enum led_color color, bool enable)
{
	struct led_obj *ptr;

	if (color >= LED_MAX) {
		return -EINVAL;
	}

	ptr = get_led_obj();
	if (ptr == NULL) {
		return -ENOMEM;
	}

	ptr->led = &led_dev[color];
	if (enable) {
		ptr->action = LED_ACTION_ON;
	} else {
		ptr->action = LED_ACTION_OFF;
	}
	k_fifo_put(&led_fifo, ptr);

	return 0;
}

int led_blink_fast(enum led_color color, uint8_t cnt)
{
	int ret;

	ret = led_blink(color, cnt, LED_ACTION_BLINK_FAST);

	if (ret) {
		LOG_WRN("%s: failed", __FUNCTION__);
	}

	return ret;
}

int led_blink_slow(enum led_color color, uint8_t cnt)
{
	int ret;

	ret = led_blink(color, cnt, LED_ACTION_BLINK_SLOW);

	if (ret) {
		LOG_WRN("%s: failed", __FUNCTION__);
	}

	return ret;
}
```

## src/motor.c
```c
/*
 * Copyright (c) 2012-2014 Wind River Systems, Inc.
 * Copyright (c) 2020 Prevas A/S
 *
 * SPDX-License-Identifier: Apache-2.0
 */
#include <stdlib.h>
#include <zephyr.h>
#include <stats/stats.h>
#include <devicetree.h>
#include <drivers/gpio.h>
#include <drivers/pwm.h>

#define LOG_LEVEL LOG_LEVEL_DBG
#include <logging/log.h>

#include <shell/shell.h>
#include "config.h"
#include "motor.h"
#include "encoder.h"

LOG_MODULE_REGISTER(motor);

/* The devicetree node identifier for the "hbridge-en" alias. */
#define HBRIDGE_ENABLE_NODE DT_ALIAS(hbridge_en)

#if DT_NODE_HAS_STATUS(HBRIDGE_ENABLE_NODE, okay)
#define HBRIDGE_EN_LABEL	DT_GPIO_LABEL(HBRIDGE_ENABLE_NODE, gpios)
#define HBRIDGE_EN_PIN		DT_GPIO_PIN(HBRIDGE_ENABLE_NODE, gpios)
#define HBRIDGE_EN_FLAGS	DT_GPIO_FLAGS(HBRIDGE_ENABLE_NODE, gpios)
#else
/* A build error here means your board isn't set up to control Hbridge. */
#error "Unsupported board: HBRIDGE_EN devicetree alias is not defined"
#endif

/* The devicetree node identifier for the "pwm-ch0" alias. */
#define PWM_CH0_NODE DT_ALIAS(pwm_ch0)

#if DT_NODE_HAS_STATUS(PWM_CH0_NODE, okay)
#define PWM0_LABEL       DT_PWMS_LABEL(PWM_CH0_NODE)
#define PWM0_CHANNEL     DT_PWMS_CHANNEL(PWM_CH0_NODE)
#define PWM0_FLAGS       DT_PWMS_FLAGS(PWM_CH0_NODE)
#else
/* A build error here means your board isn't set up to use motor with PWM. */
#error "Unsupported board: PWM_CH0 devicetree alias is not defined"
#endif

/* The devicetree node identifier for the "pwm-ch1" alias. */
#define PWM_CH1_NODE DT_ALIAS(pwm_ch1)

#if DT_NODE_HAS_STATUS(PWM_CH1_NODE, okay)
#define PWM1_LABEL       DT_PWMS_LABEL(PWM_CH1_NODE)
#define PWM1_CHANNEL     DT_PWMS_CHANNEL(PWM_CH1_NODE)
#define PWM1_FLAGS       DT_PWMS_FLAGS(PWM_CH1_NODE)
#else
/* A build error here means your board isn't set up to use motor with PWM. */
#error "Unsupported board: PWM_CH1 devicetree alias is not defined"
#endif


struct motor_cb {
	enum motor_drv_direction current_dir;
};
static struct motor_cb motor_cb;

static void hbridge_enable(bool enable)
{
	const struct device *dev;
	int ret;

	dev = device_get_binding(HBRIDGE_EN_LABEL);
	if (dev == NULL) {
		LOG_ERR("%s: Cannot bind HBRIDGE_EN", __FUNCTION__);
		return;
	}

	ret = gpio_pin_set(dev, HBRIDGE_EN_PIN, (int)enable);
	if (ret) {
		LOG_ERR("%s: Cannot set output", __FUNCTION__);
		return;
	}

	if (enable) {
		k_sleep(K_MSEC(10));
	}
}

static int hbridge_init(void)
{
	const struct device *dev;
	int ret;

	dev = device_get_binding(HBRIDGE_EN_LABEL);
	if (dev == NULL) {
		LOG_ERR("Cannot bind HBRIDGE_EN");
		return -ENXIO;
	}
	ret = gpio_pin_configure(dev, HBRIDGE_EN_PIN,
				 GPIO_OUTPUT_ACTIVE | HBRIDGE_EN_FLAGS);
	if (ret < 0) {
		return -ENXIO;
	}

	hbridge_enable(false);

	return 0;
}

static int pwm_init(void)
{
	const struct device *dev;

	dev = device_get_binding(PWM0_LABEL);
	if (dev == NULL) {
		LOG_ERR("Cannot bind PWM0 device");
		return -ENXIO;
	}

	dev = device_get_binding(PWM1_LABEL);
	if (dev == NULL) {
		LOG_ERR("Cannot bind PWM1 device");
		return -ENXIO;
	}

	return 0;
}

static int pwm_ch0_set(uint32_t duty_cycle)
{
	const struct device *dev;
	int ret;

	dev = device_get_binding(PWM0_LABEL);
	if (dev == NULL) {
		LOG_WRN("%s: Cannot bind PWM0 device", __FUNCTION__);
		return -ENXIO;
	}

	ret = pwm_pin_set_usec(dev, PWM0_CHANNEL, MOTOR_PWM_PERIOD_US, duty_cycle,
				PWM0_FLAGS);
	if (ret) {
		LOG_WRN("%s: error: [%d]", __FUNCTION__, ret);
	}

	return ret;
}

static int pwm_ch1_set(uint32_t duty_cycle)
{
	const struct device *dev;
	int ret;

	dev = device_get_binding(PWM1_LABEL);
	if (dev == NULL) {
		LOG_WRN("%s: Cannot bind PWM1 device", __FUNCTION__);
		return -ENXIO;
	}

	ret = pwm_pin_set_usec(dev, PWM1_CHANNEL, MOTOR_PWM_PERIOD_US, duty_cycle,
				PWM1_FLAGS);
	if (ret) {
		LOG_WRN("%s: error: [%d]", __FUNCTION__, ret);
	}

	return ret;
}

static int pwms_set(enum motor_drv_direction direction, uint32_t duty)
{
	int ret = -EINVAL;

	if (duty > MOTOR_PWM_PERIOD_US) {
		LOG_WRN("%s: Max allowed pwm period: %d  | requested: %d",
                __FUNCTION__, MOTOR_PWM_PERIOD_US, duty);
		duty = MOTOR_PWM_PERIOD_US;
	}

	switch (direction) {
	case MOTOR_DRV_FORWARD:
		ret = pwm_ch0_set(duty);
		if (ret) {
			return ret;
		}
		ret = pwm_ch1_set(0);
		break;
	case MOTOR_DRV_BACKWARD:
		ret = pwm_ch0_set(0);
		if (ret) {
			return ret;
		}
		ret = pwm_ch1_set(duty);
		break;
	case MOTOR_DRV_BRAKE:
		ret = pwm_ch0_set(MOTOR_PWM_PERIOD_US);
		if (ret) {
			return ret;
		}
		ret = pwm_ch1_set(MOTOR_PWM_PERIOD_US);
		break;
	case MOTOR_DRV_NEUTRAL:
		ret = pwm_ch0_set(0);
		if (ret) {
			return ret;
		}
		ret = pwm_ch1_set(0);
		break;
	default:
		break;
	}

	return ret;
}

static int check_direction(enum motor_drv_direction direction)
{
	if (direction >= MOTOR_DRV_MAX) {
		LOG_WRN("Unrecognized motor request: %d", direction);
		return -EINVAL;
	}

	if (((direction == MOTOR_DRV_FORWARD) &&
	     (motor_cb.current_dir == MOTOR_DRV_BACKWARD)) ||
	    ((direction == MOTOR_DRV_BACKWARD) &&
	     (motor_cb.current_dir == MOTOR_DRV_FORWARD))) {
		LOG_WRN("Requested oposite direction. "
			"Current: %d, Requested: %d",
			motor_cb.current_dir, direction);

		return -EINVAL;
	}

	return 0;
}

int motor_init(void)
{
	int ret;

	ret = hbridge_init();
	if (ret) {
		LOG_ERR("Hbridge Init error: [%d]", ret);
		return ret;
	} else {
		LOG_INF("Hbridge initialized");
	}

	ret = pwm_init();
	if (ret) {
		LOG_ERR("PWM Init error: [%d]", ret);
		return ret;
	} else {
		LOG_INF("PWM channels initialized");
	}


	motor_move(MOTOR_DRV_NEUTRAL, 0);

	return 0;
}

/* Function for driving the motor.
 *
 * @param[in] direction	movement direction
 * @param[in] speed	impulses per second
 */
int motor_move(enum motor_drv_direction direction, uint32_t speed)
{
	static const char *lookup[] = {"NEUTRAL", "FORWARD", "BACKWARD", "BRAKE"};
	int ret;

	ret = check_direction(direction);
	if (ret) {
		return ret;
	}

	hbridge_enable(true);
	ret = pwms_set(direction, speed);

	if (ret) {
		LOG_ERR("%s: error: [%d]", __FUNCTION__, ret);
	} else {
		LOG_INF("Motor move.\n\rdirection: [%s]\r\nduty_cycle: [%d/%d]",
			lookup[direction], speed, MOTOR_PWM_PERIOD_US);
	}

	return ret;
}
```

## src/pid.c
```c
//-----------------------------------------------------------------------------
//
//  Copyright 2017 Jakub Rzeszutko, All Rights Reserved
//
//  Module:         Pid.c
//  Creator:        Jakub Rzeszutko
//  email:          projekty@rzeszutko.eu
//
//-----------------------------------------------------------------------------
//  Project:        ComShooting - Transporter
//-----------------------------------------------------------------------------
//
//
//
//----------------- INCLUDE DIRECTIVES FOR OTHER HEADERS ----------------------
#include <stdlib.h>
#include <shell/shell.h>
#include "pid.h"
#include "config.h"

#define LOG_LEVEL LOG_LEVEL_DBG
#include <logging/log.h>
LOG_MODULE_REGISTER(pid);

//---------------------- LOCAL DEFINES FOR CONSTANTS --------------------------

//---------------------- LOCAL DEFINE MACROS (#, ##)---------------------------

//-----------------------------------------------------------------------------
//---------------------- LOCAL TYPEDEF DECLARATIONS ---------------------------
//-----------------------------------------------------------------------------

//-------------------------------- ENUMS --------------------------------------

//------------------------------- STRUCT --------------------------------------

//------------------------------- UNIONS --------------------------------------

//-----------------------------------------------------------------------------
//-------------------------- OBJECT DEFINITIONS -------------------------------
//-----------------------------------------------------------------------------

//--------------------------- EXPORTED OBJECTS --------------------------------

//---------------------------- LOCAL OBJECTS ----------------------------------
static int32_t m_sum_error;
static int32_t k_i;
static int32_t k_p;

//-----------------------------------------------------------------------------
//----------------------- LOCAL FUNCTION PROTOTYPES ---------------------------
//-----------------------------------------------------------------------------


//-----------------------------------------------------------------------------
//---------------------------- LOCAL FUNCTIONS --------------------------------
//-----------------------------------------------------------------------------

//=============================================================================
// FUNCTION: Fo
//-----------------------------------------------------------------------------
// DESCRIPTION:
//   <Description>
//
// PREEMPTABLE: No
// REENTRANT:   No
//
// PARAMETERS:   void
//
//
// RETURN VALUE: void
//
//=============================================================================

//-----------------------------------------------------------------------------
//--------------------------- EXPORTED FUNCTIONS ------------------------------
//-----------------------------------------------------------------------------


//=============================================================================
// FUNCTION: PID_Init
//=============================================================================
void PID_Init(void)
{
	const uint32_t *ptr;

	m_sum_error = 0;

	ptr = config_param_get(CONFIG_PARAM_PID_KP);
	k_p = *ptr;
	ptr = config_param_get(CONFIG_PARAM_PID_KI);
	k_i = *ptr;
}

//=============================================================================
// FUNCTION: PID_Controller
//=============================================================================
uint16_t PID_Controller(pid_data_t *pid)
{
	int32_t error;
	int32_t term_p;
	int32_t regulator;
	int32_t integrator;

	if (NULL == pid) {
		return 0;
	}

	error = (int32_t)((int32_t)pid->set_value - (int32_t)pid->measured_value);
	term_p = k_p * error;
	m_sum_error += error;

	LOG_INF("set = %d | measured = %d | sum_error = %d",
		pid->set_value, pid->measured_value, m_sum_error);

	integrator = m_sum_error / k_i;
	regulator = (term_p + integrator);

	if (regulator > pid->max_val) {
		regulator = pid->max_val;
	} else if (regulator < pid->min_val) {
		regulator = pid->min_val;
	}

	return regulator;
}

static int cmd_pid_kp(const struct shell *shell, size_t argc, char **argv)
{
	k_p = (int32_t)strtol(argv[1], NULL, 10);
	return 0;
}

static int cmd_pid_ki(const struct shell *shell, size_t argc, char **argv)
{
	k_i = (int32_t)strtol(argv[1], NULL, 10);
	return 0;
}

static int cmd_pid(const struct shell *shell, size_t argc, char **argv)
{
	shell_print(shell, "K_P = %d | K_I = %d", k_p, k_i);
	return 0;
}

SHELL_STATIC_SUBCMD_SET_CREATE(sub_pid,
	SHELL_CMD(kp, NULL, "Update K_P factor", cmd_pid_kp),
	SHELL_CMD(ki, NULL, "Update K_I factor.", cmd_pid_ki),
	SHELL_SUBCMD_SET_END /* Array terminated. */
);
SHELL_CMD_REGISTER(pid, &sub_pid, "Print PID parameters", cmd_pid);
//=============================================================================
// Date         ver     subm        Content
//=============================================================================
//-----------------------------------------------------------------------------
// 17-01-22     01      JRZ         Basic functionality
//-----------------------------------------------------------------------------
```
